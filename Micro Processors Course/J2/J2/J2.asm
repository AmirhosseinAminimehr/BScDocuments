.include "m1280def.inc"
		LDI		R16,HIGH(RAMEND)
		OUT		SPH,R16
		LDI		R16,LOW(RAMEND)
		OUT		SPL,R16
		LDI	R27,0XFF
		OUT	DDRF,R27
		STS	DDRK,R27


START:
		LDI 	R22,0
		LDI		R23,0
		LDI		R24,0
		LDI		R25,0
		LDI		R26,0

YEKAN:
		INC		R25
		MOV		R21,R22
		CALL	CONVERT
		STS		PORTK,R21
		LDI		R21,0x80
		OUT		PORTF,R21
		CALL 	DELAY

		MOV		R21,R23
		CALL	CONVERT
		STS		PORTK,R21
		LDI		R21,0x40
		OUT		PORTF,R21
		CALL 	DELAY

		MOV		R21,R24
		CALL	CONVERT
		STS		PORTK,R21
		LDI		R21,0x20
		OUT		PORTF,R21
		CALL	DELAY

		MOV		R21,R26
		CALL	CONVERT
		STS		PORTK,R21
		LDI		R21,0x10
		OUT		PORTF,R21
		CALL	DELAY

		CPI		R25,100
		BRNE	YEKAN
		LDI		R25,0
		CPI		R22,9
		BREQ	DAHGAN	
		INC		R22
		RJMP	YEKAN	

DAHGAN:
		LDI		R22,0
		;CALL 	DELAY
		CPI		R23,9
		BREQ	SADGAN
		INC		R23
		RJMP	YEKAN


SADGAN:
		LDI		R23,0
		;CALL 	DELAY
		CPI		R24,9
		BREQ	HEZARGAN
		INC		R24
		RJMP	YEKAN

HEZARGAN:
		LDI		R24,0
		;CALL 	DELAY
		CPI		R26,9
		BREQ	START
		INC		R26
		RJMP	YEKAN

















DELAY:
		LDI R18,0X1F
	LD1: 
		LDI	R19,0XFF
	LD2:	
		DEC R19
		BRNE LD2
		DEC R18
		BRNE LD1
		RET


CONVERT:
		CPI R21,0
		BRNE	C1
		LDI	R21,0XEB
		RET
	C1:
		CPI R21,1
		BRNE	C2
		LDI	R21,0X88
		RET	
	C2:
		CPI R21,2
		BRNE	C3
		LDI	R21,0XB3
		RET		

	C3:
		CPI R21,3
		BRNE	C4
		LDI	R21,0XBA
		RET	

	C4:
		CPI R21,4
		BRNE	C5
		LDI	R21,0XD8
		RET	

	C5:
		CPI R21,5
		BRNE	C6
		LDI	R21,0X7A
		RET	

	C6:
		CPI R21,6
		BRNE	C7
		LDI	R21,0X7B
		RET	
	C7:
		CPI R21,7
		BRNE	C8
		LDI	R21,0XA8
		RET	

	C8:
		CPI R21,8
		BRNE	C9
		LDI	R21,0XFB
		RET
	C9: LDI R21,0XFA
		RET
