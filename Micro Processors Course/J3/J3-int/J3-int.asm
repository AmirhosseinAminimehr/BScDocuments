.include "m1280def.inc"
.ORG	0
		RJMP MAIN
.ORG	OC1Aaddr
		RJMP 	OC1Aaddr_ROUTINE
.ORG	OC0Aaddr
		RJMP	OC0Aaddr_ROUTINE


MAIN:
		LDI		R16,HIGH(RAMEND)
		OUT		SPH,R16
		LDI		R16,LOW(RAMEND)
		OUT		SPL,R16
		LDI	R27,0XFF
		OUT	DDRF,R27
		STS	DDRK,R27


START:
		LDI		R20,1
		LDI 	R22,0
		LDI		R23,0
		LDI		R24,0
		LDI		R25,0


SET_TIMER0:
		LDI		R16, 0x02
		OUT		TCCR0A,R16

		LDI		R16, 0x05
		OUT		TCCR0B,R16

		LDI		R16, 22
		OUT		OCR0A,R16

		LDI		R16, 0x02
		STS		TIMSK0,R16

SET_TIMER1:
		LDI		R16, 0x00
		STS		TCCR1A,R16

		LDI		R16, 0x0D
		STS		TCCR1B,R16

		LDI		R16, HIGH(10800)
		STS		OCR1AH,R16
		LDI		R16,LOW(10800)
		STS		OCR1AL,R16
		SEI
		LDI		R16, 0x02
		STS		TIMSK1, R16

;WAIT FOR INT
HERE:	RJMP	HERE

OC0Aaddr_ROUTINE:
		;DISPLAY NEXT 7SEG
		CPI		R20,1
		BREQ	SHOW_YEKAN
		CPI		R20,2
		BREQ	SHOW_DAHGAN
		CPI		R20,3
		BREQ	SHOW_SADGAN
		CPI		R20,4
		BREQ	SHOW_HEZARGAN

SHOW_YEKAN:
		MOV		R21,R22
		CALL	CONVERT
		STS		PORTK,R21
		LDI		R21,0x80
		OUT		PORTF,R21
		INC		R20
		RETI

SHOW_DAHGAN:
		MOV		R21,R23
		CALL	CONVERT
		STS		PORTK,R21
		LDI		R21,0x40
		OUT		PORTF,R21
		INC		R20
		RETI

SHOW_SADGAN:
		MOV		R21,R24
		CALL	CONVERT
		ORI		R21,0x04
		STS		PORTK,R21
		LDI		R21,0x20
		OUT		PORTF,R21
		INC		R20
		RETI

SHOW_HEZARGAN:
		MOV		R21,R25
		CALL	CONVERT
		STS		PORTK,R21
		LDI		R21,0x10
		OUT		PORTF,R21
		LDI		R20,1
		RETI
		
		
		


OC1Aaddr_ROUTINE:
		;INC
		CPI		R22,9
		BREQ	DAHGAN
		INC		R22
		RETI
	DAHGAN:
		LDI		R22,0
		CPI		R23,5
		BREQ	SADGAN
		INC		R23
		RETI
	SADGAN:
		LDI		R23,0
		CPI		R24,9
		BREQ	HEZARGAN
		INC		R24
		RETI
	HEZARGAN:
		LDI		R24,0
		CPI		R25,5
		BREQ	RESET_TIMER
		INC		R25
		RETI
	RESET_TIMER:
		LDI		R22,0
		LDI		R23,0
		LDI		R24,0
		LDI		R25,0
		RETI













DELAY:
		LDI R18,0X1F
	LD1: 
		LDI	R19,0XFF
	LD2:	
		DEC R19
		BRNE LD2
		DEC R18
		BRNE LD1
		RET


CONVERT:
		CPI R21,0
		BRNE	C1
		LDI	R21,0XEB
		RET
	C1:
		CPI R21,1
		BRNE	C2
		LDI	R21,0X88
		RET	
	C2:
		CPI R21,2
		BRNE	C3
		LDI	R21,0XB3
		RET		

	C3:
		CPI R21,3
		BRNE	C4
		LDI	R21,0XBA
		RET	

	C4:
		CPI R21,4
		BRNE	C5
		LDI	R21,0XD8
		RET	

	C5:
		CPI R21,5
		BRNE	C6
		LDI	R21,0X7A
		RET	

	C6:
		CPI R21,6
		BRNE	C7
		LDI	R21,0X7B
		RET	
	C7:
		CPI R21,7
		BRNE	C8
		LDI	R21,0XA8
		RET	

	C8:
		CPI R21,8
		BRNE	C9
		LDI	R21,0XFB
		RET
	C9: LDI R21,0XFA
		RET
